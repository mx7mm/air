## configs/air_defconfig
```kconfig
# Air Configuration - Phase 1
# Absolute minimal bootable system

# =============================================================================
# Target Architecture
# =============================================================================
BR2_x86_64=y
BR2_x86_haswell=y

# =============================================================================
# Toolchain
# =============================================================================
BR2_TOOLCHAIN_BUILDROOT_MUSL=y

# =============================================================================
# System Configuration
# =============================================================================
BR2_TARGET_GENERIC_HOSTNAME="air"
BR2_TARGET_GENERIC_ISSUE="Air OS"
BR2_TARGET_GENERIC_ROOT_PASSWD=""
BR2_TARGET_GENERIC_GETTY_PORT="tty1"
BR2_TARGET_GENERIC_GETTY_BAUDRATE_115200=y
BR2_SYSTEM_BIN_SH_BUSYBOX=y
BR2_ROOTFS_OVERLAY="$(BR2_EXTERNAL_air_PATH)/board/air/rootfs-overlay"

# =============================================================================
# Kernel (minimal)
# =============================================================================
BR2_LINUX_KERNEL=y
BR2_LINUX_KERNEL_CUSTOM_VERSION=y
BR2_LINUX_KERNEL_CUSTOM_VERSION_VALUE="6.6"
BR2_LINUX_KERNEL_USE_DEFCONFIG=y
BR2_LINUX_KERNEL_DEFCONFIG="x86_64"
BR2_LINUX_KERNEL_CONFIG_FRAGMENT_FILES="$(BR2_EXTERNAL_air_PATH)/board/air/linux.config"
BR2_LINUX_KERNEL_INSTALL_TARGET=y

# =============================================================================
# Init System
# =============================================================================
BR2_INIT_BUSYBOX=y

# =============================================================================
# Filesystem
# =============================================================================
BR2_TARGET_ROOTFS_EXT2=y
BR2_TARGET_ROOTFS_EXT2_4=y
BR2_TARGET_ROOTFS_EXT2_SIZE="128M"

# =============================================================================
# Bootloader
# =============================================================================
BR2_TARGET_GRUB2=y
BR2_TARGET_GRUB2_X86_64_EFI=y
BR2_TARGET_GRUB2_INSTALL_TOOLS=y

# =============================================================================
# Host Tools (for image generation only)
# =============================================================================
BR2_PACKAGE_HOST_DOSFSTOOLS=y
BR2_PACKAGE_HOST_GENIMAGE=y
BR2_PACKAGE_HOST_MTOOLS=y

# =============================================================================
# Image Generation
# =============================================================================
BR2_ROOTFS_POST_IMAGE_SCRIPT="$(BR2_EXTERNAL_air_PATH)/board/air/post-image.sh"
BR2_ROOTFS_POST_SCRIPT_ARGS="-c $(BR2_EXTERNAL_air_PATH)/board/air/genimage.cfg"
```

## sammelordner/Config.in
```kconfig
config BR2_EXTERNAL_air_PATH
    string
    option env="BR2_EXTERNAL_air_PATH"

source "$BR2_EXTERNAL_air_PATH/board/air/Config.in"
```
